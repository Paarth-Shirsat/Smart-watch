## app/boards/watch_esp32/Kconfig
```kconfig
config BOARD_WATCH_ESP32
    select SOC_ESP32S3
    select SOC_SERIES_ESP32S3

config BOARD
    default "watch_esp32"
```

## app/boards/watch_esp32/board.yml
```yaml
board:
  name: watch_esp32
  full_name: Custom Smartwatch (ESP32-S3 prototype)
  vendor: espressif
  socs:
  - name: esp32s3
```
